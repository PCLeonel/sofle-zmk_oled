## Kconfig
```kconfig
# Copyright (c) 2026 Leonel Pinheiro Correa
# SPDX-License-Identifier: MIT

menu "Leonel Sofle OLED"

config LEONEL_SOFLE_OLED
    bool "Custom OLED screen for Leonel's Sofle"
    default y
    depends on ZMK_DISPLAY
    select LV_USE_LABEL
    help
      Enables the custom 128x32 OLED status screen for the Sofle.

      The central side displays:
        - owner name
        - local battery percentage
        - active Bluetooth profile
        - Bluetooth connection status
        - active layer
        - words per minute

      The peripheral side displays:
        - owner name
        - local battery percentage
        - side identification

endmenu
```
